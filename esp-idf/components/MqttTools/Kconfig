## esp-idf/components/MqttTools/Kconfig
```kconfig
menu "MQTT configuration"

    config MQTT_BROKER_URL
        string "MQTT broker URL"
        default "mqtt://mosquitto.home.arpa"
        help
            URI of the MQTT broker. Examples:
            mqtt://mosquitto.home.arpa
            mqtt://192.168.1.10:1883

    config MQTT_TOPIC_PREFIX
        string "MQTT topic prefix"
        default "dashboard"
        help
            Leading segment for all subscribed topics.
            e.g. "dashboard" → dashboard/bus_stops, dashboard/weather, etc.
            Change per device (e.g. "dashboard-dev") to isolate dev/prod traffic
            on the same broker.

endmenu
```

## esp-idf/components/Wireless/Kconfig
```kconfig
menu "WiFi configuration"

    config WIFI_SSID
        string "WiFi SSID"
        default ""
        help
            Network name to connect to. Set in sdkconfig.defaults.local.

    config WIFI_PASSWORD
        string "WiFi password"
        default ""
        help
            WiFi password. Leave empty for open networks.
            Set in sdkconfig.defaults.local.

    config WIFI_USE_STATIC_IP
        bool "Use static IP address"
        default n
        help
            Assign a fixed IP instead of using DHCP.

    config WIFI_IP_ADDRESS
        string "Static IP address"
        default ""
        depends on WIFI_USE_STATIC_IP

    config WIFI_GATEWAY
        string "Gateway"
        default ""
        depends on WIFI_USE_STATIC_IP

    config WIFI_SUBNET
        string "Subnet mask"
        default "255.255.255.0"
        depends on WIFI_USE_STATIC_IP

    config WIFI_DNS1
        string "Primary DNS"
        default "8.8.8.8"
        depends on WIFI_USE_STATIC_IP

    config WIFI_DNS2
        string "Secondary DNS"
        default "8.8.4.4"
        depends on WIFI_USE_STATIC_IP

endmenu
```

## platformio/components/ClockTools/Kconfig
```kconfig
menu "Clock configuration"

    config CLOCK_POSIX_TZ
        string "POSIX timezone string"
        default "UTC0"
        help
            POSIX TZ string for the local timezone, applied before NTP sync.

            Examples:
              UTC0
              GMT0BST,M3.5.0/1,M10.5.0    (UK / Ireland with BST)
              CET-1CEST,M3.5.0,M10.5.0/3  (Central Europe)
              EST5EDT,M3.2.0,M11.1.0       (US Eastern)
              PST8PDT,M3.2.0,M11.1.0       (US Pacific)

            See https://www.gnu.org/software/libc/manual/html_node/TZ-Variable.html

endmenu
```

## platformio/sdkconfig.defaults
```kconfig
# CPU frequency (240 MHz as specified by board)
CONFIG_ESP_DEFAULT_CPU_FREQ_MHZ_240=y
CONFIG_ESP_DEFAULT_CPU_FREQ_MHZ=240

# Flash mode and frequency (QIO, 80 MHz as specified by board)
CONFIG_ESPTOOLPY_FLASHMODE_QIO=y
CONFIG_ESPTOOLPY_FLASHFREQ_80M=y

# PSRAM (Octal mode for ESP32-S3)
CONFIG_SPIRAM=y
CONFIG_SPIRAM_MODE_OCT=y
CONFIG_SPIRAM_SPEED_80M=y
CONFIG_SPIRAM_BOOT_INIT=y
CONFIG_SPIRAM_ALLOW_BSS_SEG_EXTERNAL_MEMORY=y

# Disable Bluetooth (memory saving, replaces esp_bt_controller_mem_release call)
CONFIG_BT_ENABLED=n

# USB CDC console (replaces ARDUINO_USB_CDC_ON_BOOT=1)
CONFIG_ESP_CONSOLE_USB_CDC=y

# Flash size
CONFIG_ESPTOOLPY_FLASHSIZE_16MB=y

# HTTP client
CONFIG_ESP_HTTP_CLIENT_ENABLE_HTTPS=n

# Main task stack (needs headroom for HTTP + JSON parsing)
CONFIG_ESP_MAIN_TASK_STACK_SIZE=16384

# Logging
CONFIG_LOG_DEFAULT_LEVEL_DEBUG=y

# Timezone (POSIX TZ string — see components/ClockTools/Kconfig for examples)
CONFIG_CLOCK_POSIX_TZ="GMT0BST,M3.5.0/1,M10.5.0"

# Custom partition table (partitions.csv — factory app fills 16 MB flash)
CONFIG_PARTITION_TABLE_CUSTOM=y
CONFIG_PARTITION_TABLE_CUSTOM_FILENAME="partitions.csv"

# Allow malloc/new to fall back to SPIRAM when internal heap is exhausted.
# Needed because eez-framework allocates flow states via malloc (through lv_mem_alloc),
# and internal RAM is tight when the WiFi stack is running.
CONFIG_SPIRAM_USE_MALLOC=y
# Prefer internal RAM for small allocs (<= 4KB) to keep latency low
CONFIG_SPIRAM_MALLOC_ALWAYSINTERNAL=4096

# LVGL memory: use malloc (not the default 32KB internal TLSF pool).
# The managed lvgl__lvgl component uses KConfig for its build, not our lv_conf.h,
# so this KConfig entry is the only way to switch it to malloc.
# With SPIRAM_USE_MALLOC enabled, malloc falls back to PSRAM when internal RAM is full,
# giving the LVGL+eez-framework heap effectively unlimited room in the 8MB PSRAM.
CONFIG_LV_MEM_CUSTOM=y
```
